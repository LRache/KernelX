## config/Kconfig
```kconfig
#
# KernelX Configuration
#

mainmenu "KernelX Kernel Configuration"

config KERNELX_VERSION
	string
	default "5.0"

menu "Platform Configuration"

choice
	prompt "Target Architecture"
	default RISCV64
	help
	  Select the target architecture for KernelX kernel.

config RISCV64
	bool "RISC-V 64-bit"
	help
	  Support for RISC-V 64-bit architecture.

config LOONGARCH64
	bool "LoongArch 64-bit"
	help
	  Support for LoongArch 64-bit architecture (LA64).
	  Runs on QEMU `virt` machine with the bare-metal
	  `loongarch64-unknown-none` Rust target.

endchoice

config ARCH
	string
	default "riscv" if RISCV64
	default "loongarch" if LOONGARCH64
	help
	  Target architecture for the kernel.
	  Automatically selected based on the chosen platform.

config ARCH_BITS
	int
	default 64 if RISCV64
	default 64 if LOONGARCH64
	help
	  Architecture bit width (32 or 64).
	  Automatically selected based on the chosen platform.

config OBJCOPY
	string "objcopy util path"
	default "objcopy"

config AR
	string "ar util path"
	default "ar"

config READELF
	string "readelf util path"
	default "readelf"

config RUST_TARGET
	string
	default "riscv64gc-unknown-none-elf" if RISCV64
	default "loongarch64-unknown-none"   if LOONGARCH64
	help
	  Rust target specification for compilation.

endmenu

menu "Build Configuration"

choice
	prompt "Compilation Mode"
	default COMPILE_MODE_DEBUG
	help
	  Select the compilation mode for the kernel.

config COMPILE_MODE_DEBUG
	bool "Debug"
	help
	  Build kernel with debug information and no optimizations.
	  Suitable for development and debugging.

config COMPILE_MODE_RELEASE
	bool "Release"
	help
	  Build kernel with optimizations enabled.
	  Suitable for production use.

endchoice

config COMPILE_MODE
	string
	default "debug" if COMPILE_MODE_DEBUG
	default "release" if COMPILE_MODE_RELEASE

config NO_SMP
	bool "No-SMP mode (single CPU)"
	default y if QEMU_CPUS = 1
	default n
	help
	  Disable SMP support. Enables the no-smp Cargo feature, which removes
	  multi-core synchronization overhead. Set this when targeting a
	  single-CPU system or emulator configuration.

config NOLOCK
	bool "No-lock mode"
	depends on NO_SMP=y
	default n
	help
	  Disable locking in SpinLock and RWLock. Both types become thin
	  wrappers over UnsafeCell with zero synchronization overhead. SleepLock
	  keeps its waiting and wakeup semantics.
	  Only safe on single-CPU (no-smp) systems. Enabling this implicitly
	  activates the no-smp Cargo feature.

endmenu

menu "Debug Configuration"

choice
	prompt "Log Level"
	default LOG_LEVEL_TRACE
	help
	  Select the maximum log level for kernel messages.

config LOG_LEVEL_TRACE
	bool "Trace"
	help
	  Enable all log messages including trace level.
	  Most verbose logging option.

config LOG_LEVEL_DEBUG
	bool "Debug"
	help
	  Enable debug, info, warn and error messages.

config LOG_LEVEL_INFO
	bool "Info"
	help
	  Enable info, warn and error messages.

config LOG_LEVEL_WARN
	bool "Warn"
	help
	  Enable warn and error messages only.

config LOG_LEVEL_SYSCALL
	bool "Syscall Trace"
	help
	  Enable trace level logging with syscall tracing.
	  Very verbose, includes all system call traces.

endchoice

config LOG_LEVEL
	string
	default "trace" if LOG_LEVEL_TRACE
	default "debug" if LOG_LEVEL_DEBUG
	default "info" if LOG_LEVEL_INFO
	default "warn" if LOG_LEVEL_WARN

config LOG_SYSCALL
	bool "Enable Syscall Tracing"
	default n
	help
	  Enable detailed tracing of all system calls.

config LOG_SYSCALL_CPU_TIME
	bool "Enable Syscall CPU Time Tracing"
	default n
	help
	  Emit one compact debug-console record after each syscall completes:
	  syscall number, syscall name, and CPU time in microseconds. The measured
	  time uses per-thread CPU accounting, so time spent blocked or sleeping
	  is not included.

config WARN_UNIMPLEMENTED_SYSCALL
	bool "Warn on Unimplemented Syscalls"
	default y
	help
	  Enable warnings for unimplemented syscalls.

config BACKTRACE
	bool "Enable Stack Backtrace"
	default y if COMPILE_MODE_DEBUG
	default n if COMPILE_MODE_RELEASE
	help
	  Enable stack backtrace on kernel panic.
	  Embeds a symbol table into the kernel image for function name resolution.
	  Requires force-frame-pointers=yes (set automatically).

config DWARF
	bool "Emit DWARF Debug Info"
	default y if COMPILE_MODE_DEBUG
	default n if COMPILE_MODE_RELEASE
	help
	  Emit DWARF debug information into the kernel ELF.
	  This passes debuginfo=2 and strip=none to rustc and -gdwarf-4 to clib so
	  host-side tools such as addr2line and qperf-analyzer can symbolize kernel
	  addresses.

config LOCKDEP
	bool "Enable lockdep"
	default n
	help
	  Enable runtime lock dependency checking for SpinLock and SleepLock.
	  Enables the lockdep Cargo feature. Adds overhead; intended for debug
	  builds only.

config SPINLOCK_CHECK
	bool "Enable spinlock misuse checks"
	default n
	help
	  Enable lightweight runtime checks for SpinLock. This only detects
	  recursive acquisition of the same SpinLock and scheduling while
	  holding SpinLocks. Enables the spinlock-check Cargo feature.

config ENABLE_WATCHDOG
	bool "Enable scheduler watchdog"
	default y
	help
	  Enable a kernel watchdog thread that periodically reports tasks
	  stuck in uninterruptible sleep. Enables the watchdog Cargo feature.

config SCHEDULER_TIME_DEBUG
	bool "Enable scheduler time accounting"
	default n
	help
	  Track per-CPU scheduler running time and print scheduler time debug
	  snapshots from the watchdog and during shutdown.

config SCHEDULER_BLOCK_REASON_DEBUG
	bool "Enable scheduler blocked-reason time accounting"
	depends on SCHEDULER_TIME_DEBUG
	default n
	help
	  Track and report per-CPU blocked time grouped by the static blocking
	  reason. Disabling this does not affect the watchdog's blocked reason
	  recording and reporting.

endmenu

menu "Experimental Features"

config ENABLE_SWAP_MEMORY
	bool "Enable Swap Memory"
	depends on NO_SMP && !KVM
	default n
	help
	  Compile anonymous-page swap support into the kernel. QEMU runs
	  automatically attach a dedicated temporary swap disk and select it with
	  the "swap=<block-driver-name>" command-line argument. Other platforms
	  must provide that argument and a registered writable block driver.
	  File-page reclaim uses the global LRU independently of this option.

	  Swap currently requires single-CPU mode because the kernel does not yet
	  provide cross-CPU user-TLB shootdown. It is also incompatible with KVM
	  until KVM G-stage page pinning and invalidation are integrated with swap.

config KVM
	bool "Enable KVM"
	depends on RISCV64
	default n
	help
	  Enable experimental KVM support.
	  This option is only available when targeting the RISC-V architecture.

config FANOTIFY
	bool "Enable fanotify"
	default y
	help
	  Enable fanotify syscalls and filesystem event notifications.

config VIRTIO_BLOCK_PAGE_CACHE
	bool "Enable virtio block page cache"
	default n
	help
	  Enable a page-sized write-back cache for virtio block devices. Dirty pages
	  are written back on flush or cache eviction.

config ENABLE_LWEXT4
	bool "Enable lwext4"
	default n
	help
	  Build and register the lwext4-backed ext2 and ext3 filesystems. Ext4 and
	  ext4native continue to use the native Rust implementation.

config EXT4_NATIVE_SKIP_CRC32C_VERIFY
	bool "Skip ext4 native CRC32C verification"
	default n
	help
	  Skip read-side CRC32C verification for ext4 native metadata. Checksum
	  generation and writeback remain enabled. This option can allow corrupted
	  metadata to be accepted and is intended only for performance comparison
	  or debugging.

endmenu

menu "Boot Configuration"

config DEFAULT_BOOTARGS
	string "Default kernel boot arguments"
	default ""
	help
	  Boot arguments used by the kernel when /chosen/bootargs is empty.

endmenu

menu "QEMU Configuration"

config QEMU_MACHINE
	string "QEMU machine type"
	default "virt"
	help
	  QEMU machine type for virtualization.

config QEMU_BIOS
	string "QEMU -bios firmware (empty = omit the flag)"
	default ""
	help
	  Passed as `-bios <value>` to qemu-system-${ARCH}. Leave empty to omit
	  the flag entirely.

	  - RISC-V virt: empty lets QEMU fall back to its built-in OpenSBI.
	  - LoongArch virt: *must* be empty for raw `-kernel` boots. If you pass
	    anything (even /dev/null), QEMU loads it as firmware and skips the
	    aux_boot_code shim that hands PC off to our ELF entry, and the CPU
	    just executes zeros out of reset.

config QEMU_MEMORY
	string "QEMU memory size"
	default "256M"
	help
	  Amount of memory to allocate for QEMU virtual machine.

config QEMU_CPUS
	int "Number of CPUs"
	range 1 12
	default 1
	help
	  Number of CPU cores for QEMU virtual machine.

config QEMU_DEBUG_CONSOLE_DEVICE
	string "QEMU debug console kernel device"
	default "/dev/hvc0"
	help
	  Kernel /dev character device selected by the kdebug_console bootarg.
	  QEMU attaches a virtio console for this device by default.

config QEMU_DEBUG_CONSOLE_LOG
	string "QEMU debug console output file"
	default "build/riscv64/debug-console.log" if RISCV64
	default "build/loongarch64/debug-console.log" if LOONGARCH64
	help
	  Host file used as the QEMU virtio debug console backend. Kernel debug
	  output written through kprint_debug! is collected here instead of
	  sharing the main -nographic serial console.

config DISK_IMAGE
	string "Disk image path"
	default "./sdcard-rv.img" if RISCV64
	default "./sdcard-la.img" if LOONGARCH64
	help
	  Path to the disk image file used as storage.

config QEMU_SNAPSHOT
	bool "Load disk images in snapshot mode"
	default n
	help
	  Pass snapshot=on for QEMU disk images. Guest writes go to temporary
	  overlays and are discarded when QEMU exits.

config SECOND_DISK_IMAGE
	string "Second disk image path"
	default ""
	help
	  Path to the optional second disk image file used as storage.
	  If empty, QEMU uses a temporary raw disk as the second disk.

config SECOND_DEVICE
	string "Second disk device name to mount"
	default ""
	help
	  Kernel block device name for the second disk. Leave empty to attach
	  the second disk without mounting it automatically.

	  Typical values:
	  - RISC-V virtio-mmio: virtio_mmio@10002000
	  - LoongArch virtio-pci: virtio_block1

config SECOND_FSTYPE
	string "Second disk filesystem type"
	default "ext4"
	help
	  Filesystem type used when mounting SECOND_DEVICE.

config SECOND_MOUNTPOINT
	string "Second disk mount point"
	default "/mnt"
	help
	  Absolute path where SECOND_DEVICE is mounted. The kernel creates this
	  single-level directory during boot when it does not already exist.

config QEMU_SWAP_SIZE_MIB
	int "Dedicated swap disk size (MiB)"
	depends on ENABLE_SWAP_MEMORY
	range 1 1048576
	default 1024
	help
	  Size of the dedicated raw swap disk created under /tmp for QEMU runs.
	  The temporary disk is independent of SECOND_DISK_IMAGE and is removed
	  when QEMU exits.

config INITPATH
	string "Init process path"
	default "/init"
	help
	  Path to the init process executable.

config INITARGS
	string "Init process arguments"
	default ""
	help
	  Additional arguments to pass to the init process.

config INITCWD
	string "Init process working directory"
	default "/"
	help
	  Working directory for the init process.

config ROOT_DEVICE
	string "Root device name"
	default "virtio_block0"
	help
	  Device path for the root filesystem.

config ROOT_FSTYPE
	string "Root filesystem type"
	default "ext4"
	help
	  Filesystem type for the root filesystem (bootarg name rootfstype).

config BOOTARGS
	string "Additional boot arguments"
	default ""
	help
	  Additional kernel boot arguments.

endmenu
```

## usertests/kvm/guest/linux5.15/kernelx_kvm_guest_defconfig
```kconfig
CONFIG_SYSVIPC=y
CONFIG_NO_HZ_IDLE=y
CONFIG_HIGH_RES_TIMERS=y
CONFIG_BPF_SYSCALL=y
CONFIG_IKCONFIG=y
CONFIG_IKCONFIG_PROC=y
CONFIG_CGROUPS=y
CONFIG_CGROUP_SCHED=y
CONFIG_CFS_BANDWIDTH=y
CONFIG_CGROUP_BPF=y
CONFIG_NAMESPACES=y
CONFIG_USER_NS=y
CONFIG_CHECKPOINT_RESTORE=y
CONFIG_BLK_DEV_INITRD=y
CONFIG_EXPERT=y
# CONFIG_SYSFS_SYSCALL is not set
CONFIG_PERF_EVENTS=y
CONFIG_SMP=y
# CONFIG_RISCV_ISA_C is not set
CONFIG_CMDLINE="earlycon=sbi loglevel=8"
CONFIG_CMDLINE_FORCE=y
# CONFIG_EFI is not set
CONFIG_PM=y
CONFIG_JUMP_LABEL=y
CONFIG_MODULES=y
CONFIG_MODULE_UNLOAD=y
CONFIG_SPARSEMEM_MANUAL=y
CONFIG_PCI=y
CONFIG_PCIEPORTBUS=y
CONFIG_PCI_HOST_GENERIC=y
CONFIG_PCIE_XILINX=y
CONFIG_DEVTMPFS=y
CONFIG_DEVTMPFS_MOUNT=y
CONFIG_BLK_DEV_LOOP=y
CONFIG_BLK_DEV_RAM=y
CONFIG_VIRTIO_BLK=y
CONFIG_BLK_DEV_NVME=m
CONFIG_BLK_DEV_SD=y
CONFIG_BLK_DEV_SR=y
CONFIG_SCSI_VIRTIO=y
CONFIG_ATA=y
CONFIG_SATA_AHCI=y
CONFIG_SATA_AHCI_PLATFORM=y
CONFIG_INPUT_MOUSEDEV=y
# CONFIG_VT is not set
CONFIG_SERIAL_8250=y
CONFIG_SERIAL_8250_CONSOLE=y
CONFIG_SERIAL_OF_PLATFORM=y
CONFIG_SERIAL_EARLYCON_RISCV_SBI=y
CONFIG_SERIAL_SIFIVE=y
CONFIG_SERIAL_SIFIVE_CONSOLE=y
CONFIG_HVC_RISCV_SBI=y
CONFIG_VIRTIO_CONSOLE=y
CONFIG_HW_RANDOM=y
CONFIG_HW_RANDOM_VIRTIO=y
CONFIG_SPI=y
CONFIG_SPI_SIFIVE=y
CONFIG_GPIOLIB=y
CONFIG_GPIO_SIFIVE=y
CONFIG_POWER_RESET=y
CONFIG_POWER_RESET_SYSCON=y
CONFIG_POWER_RESET_SYSCON_POWEROFF=y
CONFIG_THERMAL=y
CONFIG_THERMAL_WRITABLE_TRIPS=y
CONFIG_THERMAL_GOV_USER_SPACE=y
CONFIG_DRM=m
CONFIG_DRM_RADEON=m
CONFIG_DRM_NOUVEAU=m
CONFIG_DRM_VIRTIO_GPU=m
CONFIG_FB=y
CONFIG_USB=y
CONFIG_USB_XHCI_HCD=y
CONFIG_USB_XHCI_PLATFORM=y
CONFIG_USB_EHCI_HCD=y
CONFIG_USB_EHCI_HCD_PLATFORM=y
CONFIG_USB_OHCI_HCD=y
CONFIG_USB_OHCI_HCD_PLATFORM=y
CONFIG_USB_STORAGE=y
CONFIG_USB_UAS=y
CONFIG_MMC=y
CONFIG_MMC_SDHCI=y
CONFIG_MMC_SDHCI_PLTFM=y
CONFIG_MMC_SDHCI_CADENCE=y
CONFIG_MMC_SPI=y
CONFIG_RTC_CLASS=y
CONFIG_RTC_DRV_GOLDFISH=y
CONFIG_VIRTIO_PCI=y
CONFIG_VIRTIO_BALLOON=y
CONFIG_VIRTIO_INPUT=y
CONFIG_VIRTIO_MMIO=y
CONFIG_GOLDFISH=y
CONFIG_MAILBOX=y
CONFIG_RPMSG_VIRTIO=y
CONFIG_RESET_CONTROLLER=y
CONFIG_EXT4_FS=y
CONFIG_EXT4_FS_POSIX_ACL=y
CONFIG_AUTOFS4_FS=y
CONFIG_MSDOS_FS=y
CONFIG_VFAT_FS=y
CONFIG_TMPFS=y
CONFIG_TMPFS_POSIX_ACL=y
CONFIG_NLS_CODEPAGE_437=y
CONFIG_NLS_ISO8859_1=m
CONFIG_KEYS=y
CONFIG_CRYPTO_DEV_VIRTIO=y
CONFIG_PRINTK_TIME=y
CONFIG_DEBUG_INFO=y
CONFIG_DEBUG_FS=y
CONFIG_DEBUG_PAGEALLOC=y
CONFIG_SCHED_STACK_END_CHECK=y
CONFIG_DEBUG_VM=y
CONFIG_DEBUG_VM_PGFLAGS=y
CONFIG_DEBUG_MEMORY_INIT=y
CONFIG_DEBUG_PER_CPU_MAPS=y
CONFIG_SOFTLOCKUP_DETECTOR=y
CONFIG_WQ_WATCHDOG=y
CONFIG_DEBUG_TIMEKEEPING=y
CONFIG_DEBUG_RT_MUTEXES=y
CONFIG_DEBUG_SPINLOCK=y
CONFIG_DEBUG_MUTEXES=y
CONFIG_DEBUG_RWSEMS=y
CONFIG_DEBUG_ATOMIC_SLEEP=y
CONFIG_STACKTRACE=y
CONFIG_DEBUG_LIST=y
CONFIG_DEBUG_PLIST=y
CONFIG_DEBUG_SG=y
# CONFIG_RCU_TRACE is not set
CONFIG_RCU_EQS_DEBUG=y
# CONFIG_FTRACE is not set
# CONFIG_RUNTIME_TESTING_MENU is not set
CONFIG_MEMTEST=y
```
